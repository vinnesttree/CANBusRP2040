## CMakeLists.txt
```
# Copyright (c) 2026 CANBusRP2040 contributors
# SPDX-License-Identifier: Apache-2.0

cmake_minimum_required(VERSION 3.20.0)

find_package(Zephyr REQUIRED HINTS $ENV{ZEPHYR_BASE})
project(phoenix6_test)

target_sources(app PRIVATE src/proto.c src/desc.c src/client.c)
# Private protocol header of the library
target_include_directories(app PRIVATE ${CMAKE_CURRENT_SOURCE_DIR}/../../../lib/phoenix6)
```

## prj.conf
```kconfig
CONFIG_ZTEST=y
CONFIG_SERIAL=y
CONFIG_UART_INTERRUPT_DRIVEN=y
CONFIG_EMUL=y
CONFIG_UART_EMUL=y
CONFIG_PHOENIX6=y
CONFIG_LOG=y
CONFIG_ZTEST_THREAD_PRIORITY=0
CONFIG_ZTEST_STACK_SIZE=4096
```

## app.overlay
```dts
/*
 * Copyright (c) 2026 CANBusRP2040 contributors
 *
 * SPDX-License-Identifier: Apache-2.0
 */

/ {
	euart0: uart-emul0 {
		compatible = "zephyr,uart-emul";
		status = "okay";
		tx-fifo-size = <2048>;
		rx-fifo-size = <2048>;
	};
};
```

## src/client.c
```c
/*
 * Copyright (c) 2026 CANBusRP2040 contributors
 *
 * SPDX-License-Identifier: Apache-2.0
 *
 * Bridge client against a fake host bridge on the UART emulator.
 */

#include <string.h>

#include <zephyr/drivers/serial/uart_emul.h>
#include <zephyr/kernel.h>
#include <zephyr/sys/byteorder.h>
#include <zephyr/ztest.h>

#include <canbus_rp2040/phoenix6.h>

#include "phoenix6_proto.h"

static const struct device *const uart_dev = DEVICE_DT_GET(DT_NODELABEL(euart0));

/* Fake host behaviour */
static struct {
	atomic_t silent; /* do not answer anything */
	atomic_t reject; /* answer HELLO with a wrong schema hash */
	atomic_t answer; /* answer requests with RESULT */
	atomic_t hellos;
	atomic_t pings;
	atomic_t enables;
	int32_t status;
	double value;
	uint16_t seq;
} host;

struct host_msg {
	uint8_t type;
	uint16_t seq;
	uint8_t body_len;
	uint8_t body[200];
};

K_MSGQ_DEFINE(host_msgq, sizeof(struct host_msg), 16, 4);
static K_MUTEX_DEFINE(host_tx_lock);

static void host_send(uint8_t type, const uint8_t *body, size_t len)
{
	uint8_t out[PHOENIX6_MAX_ENCODED];
	int n;

	k_mutex_lock(&host_tx_lock, K_FOREVER);
	n = phoenix6_packet_encode(type, host.seq++, body, len, out, sizeof(out));
	zassert_true(n > 0);
	zassert_equal(uart_emul_put_rx_data(uart_dev, out, n), n);
	k_mutex_unlock(&host_tx_lock);
}

static void host_send_result(uint16_t seq, uint8_t type, uint8_t device, int32_t status,
			     double value)
{
	uint8_t body[16];
	struct phoenix6_writer w;

	phoenix6_writer_init(&w, body, sizeof(body));
	phoenix6_put_u16(&w, seq);
	phoenix6_put_u8(&w, type);
	phoenix6_put_u8(&w, device);
	phoenix6_put_i32(&w, status);
	phoenix6_put_f64(&w, value);
	host_send(PHOENIX6_MSG_RESULT, body, w.len);
}

static void host_handle(const struct phoenix6_packet *pkt)
{
	struct host_msg msg = {
		.type = pkt->type,
		.seq = pkt->seq,
		.body_len = MIN(pkt->body_len, sizeof(msg.body)),
	};
	uint8_t body[48];
	struct phoenix6_writer w;

	memcpy(msg.body, pkt->body, msg.body_len);

	if (atomic_get(&host.silent)) {
		return;
	}

	switch (pkt->type) {
	case PHOENIX6_MSG_HELLO:
		atomic_inc(&host.hellos);
		phoenix6_writer_init(&w, body, sizeof(body));
		phoenix6_put_u8(&w, PHOENIX6_PROTO_VERSION);
		phoenix6_put_u32(&w, atomic_get(&host.reject) ? 0x12345678U : PHOENIX6_SCHEMA_HASH);
		phoenix6_put_u8(&w, atomic_get(&host.reject) ? 0U : 1U);
		phoenix6_put_u8(&w, 6);
		memcpy(&body[w.len], "26.3.0", 6);
		host_send(PHOENIX6_MSG_HELLO_REPLY, body, w.len + 6);
		return;
	case PHOENIX6_MSG_PING:
		atomic_inc(&host.pings);
		host_send(PHOENIX6_MSG_PONG, NULL, 0);
		return;
	case PHOENIX6_MSG_ENABLE:
		atomic_inc(&host.enables);
		break;
	default:
		if (atomic_get(&host.answer) && pkt->type != PHOENIX6_MSG_SET_CONTROL) {
			host_send_result(pkt->seq, pkt->type, pkt->body[0], host.status,
					 host.value);
		}
		break;
	}

	(void)k_msgq_put(&host_msgq, &msg, K_NO_WAIT);
}

static void host_thread(void *p1, void *p2, void *p3)
{
	static struct phoenix6_frame_decoder decoder;
	struct phoenix6_packet pkt;
	uint8_t buf[256];

	phoenix6_frame_decoder_init(&decoder);

	while (true) {
		uint32_t n = uart_emul_get_tx_data(uart_dev, buf, sizeof(buf));

		for (uint32_t i = 0; i < n; i++) {
			if (phoenix6_frame_decoder_feed(&decoder, buf[i], &pkt)) {
				host_handle(&pkt);
			}
		}

		if (n == 0U) {
			k_msleep(1);
		}
	}
}

K_THREAD_DEFINE(fake_host, 2048, host_thread, NULL, NULL, NULL, 4, 0, 0);

/* Wait for the next message of a type other than PING/HELLO */
static void host_expect(uint8_t type, struct host_msg *msg)
{
	zassert_ok(k_msgq_get(&host_msgq, msg, K_MSEC(500)), "no message 0x%02x", type);
	zassert_equal(msg->type, type, "got 0x%02x, expected 0x%02x", msg->type, type);
}

static void host_reset(void)
{
	atomic_set(&host.silent, 0);
	atomic_set(&host.reject, 0);
	atomic_set(&host.answer, 1);
	host.status = 0;
	host.value = 0.0;
	k_msgq_purge(&host_msgq);
}

static void *client_setup(void)
{
	zassert_true(device_is_ready(uart_dev));
	host_reset();

	zassert_false(phoenix6_bridge_is_connected());
	zassert_equal(phoenix6_feed_enable(100), -ENOTCONN);
	zassert_ok(phoenix6_bridge_start(uart_dev));
	zassert_equal(phoenix6_bridge_start(uart_dev), -EALREADY);

	return NULL;
}

static void client_before(void *fixture)
{
	ARG_UNUSED(fixture);

	host_reset();
	zassert_ok(phoenix6_bridge_wait_connected(K_SECONDS(3)));
	k_msgq_purge(&host_msgq);
}

ZTEST(phoenix6_client, test_handshake)
{
	zassert_true(phoenix6_bridge_is_connected());
	zassert_str_equal(phoenix6_bridge_host_version(), "26.3.0");
	zassert_true(atomic_get(&host.hellos) >= 1);
}

ZTEST(phoenix6_client, test_keepalive)
{
	atomic_val_t start = atomic_get(&host.pings);

	/* Idle client: one PING per 100 ms */
	k_msleep(1000);
	zassert_within(atomic_get(&host.pings) - start, 10, 2);
	zassert_true(phoenix6_bridge_is_connected());
}

ZTEST(phoenix6_client, test_link_stays_up_while_feeding_enable)
{
	atomic_val_t pings = atomic_get(&host.pings);
	int64_t end = k_uptime_get() + 1500;

	/* ENABLE gets no answer; the PING/PONG keepalive must continue */
	while (k_uptime_get() < end) {
		zassert_ok(phoenix6_feed_enable(100));
		zassert_true(phoenix6_bridge_is_connected());
		k_msleep(20);
	}

	zassert_true(atomic_get(&host.pings) - pings >= 13);
}

ZTEST(phoenix6_client, test_link_loss_and_recovery)
{
	struct phoenix6_control req = PHOENIX6_NEUTRAL_OUT();
	int64_t start = k_uptime_get();

	atomic_set(&host.silent, 1);
	while (phoenix6_bridge_is_connected() && k_uptime_get() - start < 2000) {
		k_msleep(10);
	}

	/* The last answer arrived up to one keepalive interval before the host went silent */
	zassert_false(phoenix6_bridge_is_connected());
	zassert_true(k_uptime_get() - start >=
		     CONFIG_PHOENIX6_LINK_TIMEOUT_MS - CONFIG_PHOENIX6_KEEPALIVE_MS - 10);
	zassert_true(k_uptime_get() - start <= CONFIG_PHOENIX6_LINK_TIMEOUT_MS + 30);
	zassert_equal(phoenix6_set_control(1, &req), -ENOTCONN);
	zassert_equal(phoenix6_config_get(1, PHOENIX6_CONFIG_SLOT0_K_P, &(double){0}, 10, NULL),
		      -ENOTCONN);

	atomic_set(&host.silent, 0);
	zassert_ok(phoenix6_bridge_wait_connected(K_MSEC(500)));
}

ZTEST(phoenix6_client, test_schema_mismatch_rejected)
{
	int64_t start = k_uptime_get();

	/* Drop the link, then answer HELLO with another schema */
	atomic_set(&host.reject, 1);
	atomic_set(&host.silent, 1);
	while (phoenix6_bridge_is_connected() && k_uptime_get() - start < 2000) {
		k_msleep(10);
	}
	atomic_set(&host.silent, 0);

	zassert_equal(phoenix6_bridge_wait_connected(K_SECONDS(1)), -EPROTO);
	zassert_false(phoenix6_bridge_is_connected());

	atomic_set(&host.reject, 0);
	zassert_ok(phoenix6_bridge_wait_connected(K_SECONDS(2)));
}

ZTEST(phoenix6_client, test_feed_enable)
{
	struct host_msg msg;
	struct phoenix6_reader r;

	zassert_ok(phoenix6_feed_enable(100));
	host_expect(PHOENIX6_MSG_ENABLE, &msg);
	phoenix6_reader_init(&r, msg.body, msg.body_len);
	zassert_equal(phoenix6_get_u16(&r), 100);
	zassert_equal(r.pos, r.len);

	zassert_ok(phoenix6_feed_enable(0));
	host_expect(PHOENIX6_MSG_ENABLE, &msg);
	zassert_equal(sys_get_le16(msg.body), 0);

	/* Saturated to the field size */
	zassert_ok(phoenix6_feed_enable(100000));
	host_expect(PHOENIX6_MSG_ENABLE, &msg);
	zassert_equal(sys_get_le16(msg.body), UINT16_MAX);
}

ZTEST(phoenix6_client, test_set_control)
{
	struct phoenix6_control req = PHOENIX6_VELOCITY_VOLTAGE(10.0);
	uint8_t expected[128];
	struct phoenix6_writer w;
	struct phoenix6_reader r;
	struct host_msg msg;
	int64_t start;

	req.velocity_voltage.slot = 1;
	req.update_freq_hz = 50.0;

	zassert_equal(phoenix6_last_control_status(3), PHOENIX6_STATUS_NONE);
	zassert_ok(phoenix6_set_control(3, &req));
	host_expect(PHOENIX6_MSG_SET_CONTROL, &msg);

	phoenix6_reader_init(&r, msg.body, msg.body_len);
	zassert_equal(phoenix6_get_u8(&r), 3);
	zassert_equal(phoenix6_get_u16(&r), PHOENIX6_CONTROL_ID_VELOCITY_VOLTAGE);
	zassert_equal(phoenix6_get_f64(&r), 50.0);

	phoenix6_writer_init(&w, expected, sizeof(expected));
	zassert_ok(phoenix6_encode_control_params(&w, phoenix6_control_desc_get(req.id),
						  (const uint8_t *)&req +
							  PHOENIX6_CONTROL_PARAMS_OFFSET));
	zassert_equal(r.len - r.pos, w.len);
	zassert_mem_equal(&r.buf[r.pos], expected, w.len);

	/* Result of the request (CTR StatusCode.InvalidModeToGetSignal = -101 as an example) */
	host_send_result(msg.seq, PHOENIX6_MSG_SET_CONTROL, 3, -101, 0.0);
	start = k_uptime_get();
	while (phoenix6_last_control_status(3) == PHOENIX6_STATUS_NONE &&
	       k_uptime_get() - start < 500) {
		k_msleep(1);
	}
	zassert_equal(phoenix6_last_control_status(3), -101);
	zassert_equal(phoenix6_last_control_status(4), PHOENIX6_STATUS_NONE);

	host_send_result(msg.seq, PHOENIX6_MSG_SET_CONTROL, 3, PHOENIX6_STATUS_OK, 0.0);
	k_msleep(50);
	zassert_equal(phoenix6_last_control_status(3), PHOENIX6_STATUS_OK);
}

ZTEST(phoenix6_client, test_set_control_invalid)
{
	struct phoenix6_control req = PHOENIX6_DUTY_CYCLE_OUT(0.5);

	zassert_equal(phoenix6_set_control(63, &req), -EINVAL);
	zassert_equal(phoenix6_set_control(1, NULL), -EINVAL);
	req.id = PHOENIX6_CONTROL_ID_COUNT;
	zassert_equal(phoenix6_set_control(1, &req), -EINVAL);
	req.id = PHOENIX6_CONTROL_ID_NONE;
	zassert_equal(phoenix6_set_control(1, &req), -EINVAL);
	zassert_equal(phoenix6_last_control_status(63), PHOENIX6_STATUS_NONE);
	zassert_equal(k_msgq_num_used_get(&host_msgq), 0);
}

ZTEST(phoenix6_client, test_config_set_get)
{
	struct host_msg msg;
	struct phoenix6_reader r;
	int32_t status = 1;
	double value = 0.0;

	host.status = 0;
	host.value = 0.25;
	zassert_ok(phoenix6_config_get(5, PHOENIX6_CONFIG_SLOT0_K_P, &value, 50, &status));
	zassert_equal(status, 0);
	zassert_equal(value, 0.25);
	host_expect(PHOENIX6_MSG_CONFIG_GET, &msg);
	phoenix6_reader_init(&r, msg.body, msg.body_len);
	zassert_equal(phoenix6_get_u8(&r), 5);
	zassert_equal(phoenix6_get_u16(&r), PHOENIX6_CONFIG_SLOT0_K_P);
	zassert_equal(phoenix6_get_u16(&r), 50);
	zassert_equal(r.pos, r.len);

	host.status = -1001;
	zassert_ok(phoenix6_config_set(5, PHOENIX6_CONFIG_MOTOR_OUTPUT_NEUTRAL_MODE,
				       PHOENIX6_NEUTRAL_MODE_BRAKE, 50, &status));
	zassert_equal(status, -1001);
	host_expect(PHOENIX6_MSG_CONFIG_SET, &msg);
	phoenix6_reader_init(&r, msg.body, msg.body_len);
	zassert_equal(phoenix6_get_u8(&r), 5);
	zassert_equal(phoenix6_get_u16(&r), PHOENIX6_CONFIG_MOTOR_OUTPUT_NEUTRAL_MODE);
	zassert_equal(phoenix6_get_f64(&r), 1.0);
	zassert_equal(phoenix6_get_u16(&r), 50);
	zassert_equal(r.pos, r.len);

	zassert_equal(phoenix6_config_set(63, PHOENIX6_CONFIG_SLOT0_K_P, 0, 50, NULL), -EINVAL);
	zassert_equal(phoenix6_config_set(1, PHOENIX6_CONFIG_NONE, 0, 50, NULL), -EINVAL);
	zassert_equal(phoenix6_config_get(1, PHOENIX6_CONFIG_COUNT, &value, 50, NULL), -EINVAL);
	zassert_equal(phoenix6_config_get(1, PHOENIX6_CONFIG_SLOT0_K_P, NULL, 50, NULL), -EINVAL);
}

ZTEST(phoenix6_client, test_device_requests)
{
	struct host_msg msg;
	struct phoenix6_reader r;
	int32_t status = 1;

	zassert_ok(phoenix6_factory_default(7, 100, &status));
	zassert_equal(status, 0);
	host_expect(PHOENIX6_MSG_FACTORY_DEFAULT, &msg);
	zassert_equal(msg.body_len, 3);
	zassert_equal(msg.body[0], 7);
	zassert_equal(sys_get_le16(&msg.body[1]), 100);

	zassert_ok(phoenix6_clear_sticky_faults(7, 100, NULL));
	host_expect(PHOENIX6_MSG_CLEAR_STICKY_FAULTS, &msg);
	zassert_equal(msg.body_len, 3);

	zassert_ok(phoenix6_set_position(7, -1.5, 100, &status));
	host_expect(PHOENIX6_MSG_SET_POSITION, &msg);
	phoenix6_reader_init(&r, msg.body, msg.body_len);
	zassert_equal(phoenix6_get_u8(&r), 7);
	zassert_equal(phoenix6_get_f64(&r), -1.5);
	zassert_equal(phoenix6_get_u16(&r), 100);
	zassert_equal(r.pos, r.len);
}

ZTEST(phoenix6_client, test_request_timeout_and_late_answer)
{
	struct host_msg msg;
	double value = 0.0;
	int64_t start;

	atomic_set(&host.answer, 0);
	start = k_uptime_get();
	zassert_equal(phoenix6_config_get(2, PHOENIX6_CONFIG_SLOT0_K_P, &value, 10, NULL),
		      -ETIMEDOUT);
	zassert_within(k_uptime_get() - start, 10 + CONFIG_PHOENIX6_RESPONSE_MARGIN_MS, 20);
	host_expect(PHOENIX6_MSG_CONFIG_GET, &msg);

	/* A late answer is ignored and does not count as a control result */
	host_send_result(msg.seq, PHOENIX6_MSG_CONFIG_GET, 2, 0, 1.0);
	k_msleep(50);
	zassert_equal(phoenix6_last_control_status(2), PHOENIX6_STATUS_NONE);

	/* A result for another request does not complete a pending one */
	atomic_set(&host.answer, 1);
	host.value = 2.0;
	zassert_ok(phoenix6_config_get(2, PHOENIX6_CONFIG_SLOT0_K_P, &value, 10, NULL));
	zassert_equal(value, 2.0);
}

static void send_signals(uint8_t device, uint16_t signal, int32_t status, double value,
			 float age_ms)
{
	uint8_t body[1 + PHOENIX6_SIGNAL_ENTRY_SIZE];
	struct phoenix6_writer w;

	phoenix6_writer_init(&w, body, sizeof(body));
	phoenix6_put_u8(&w, 1);
	phoenix6_put_u8(&w, device);
	phoenix6_put_u16(&w, signal);
	phoenix6_put_i32(&w, status);
	phoenix6_put_f64(&w, value);
	phoenix6_put_f32(&w, age_ms);
	zassert_false(w.overflow);
	host_send(PHOENIX6_MSG_SIGNALS, body, w.len);
}

ZTEST(phoenix6_client, test_signals)
{
	struct phoenix6_signal_value v;
	struct host_msg msg;
	struct phoenix6_reader r;
	int32_t status = 1;
	int64_t start;

	zassert_equal(phoenix6_get_signal(9, PHOENIX6_SIGNAL_VELOCITY, &v), -ENODATA);

	zassert_ok(phoenix6_subscribe(9, PHOENIX6_SIGNAL_VELOCITY, 50.0f, &status));
	zassert_equal(status, 0);
	host_expect(PHOENIX6_MSG_SUBSCRIBE, &msg);
	phoenix6_reader_init(&r, msg.body, msg.body_len);
	zassert_equal(phoenix6_get_u8(&r), 9);
	zassert_equal(phoenix6_get_u16(&r), PHOENIX6_SIGNAL_VELOCITY);
	zassert_equal(phoenix6_get_f32(&r), 50.0f);

	zassert_equal(phoenix6_get_signal(9, PHOENIX6_SIGNAL_VELOCITY, &v), -ENODATA);

	start = k_uptime_get();
	send_signals(9, PHOENIX6_SIGNAL_VELOCITY, 0, 12.5, 3.0f);
	while (phoenix6_get_signal(9, PHOENIX6_SIGNAL_VELOCITY, &v) != 0 &&
	       k_uptime_get() - start < 500) {
		k_msleep(1);
	}
	zassert_ok(phoenix6_get_signal(9, PHOENIX6_SIGNAL_VELOCITY, &v));
	zassert_equal(v.value, 12.5);
	zassert_equal(v.status, 0);
	zassert_equal(v.age_ms, 3.0f);
	zassert_true(v.received_ms >= start);

	/* Other device / signal unaffected */
	zassert_equal(phoenix6_get_signal(8, PHOENIX6_SIGNAL_VELOCITY, &v), -ENODATA);
	zassert_equal(phoenix6_get_signal(9, PHOENIX6_SIGNAL_POSITION, &v), -ENODATA);

	/* Unsubscribe drops the cached value */
	zassert_ok(phoenix6_subscribe(9, PHOENIX6_SIGNAL_VELOCITY, 0.0f, NULL));
	host_expect(PHOENIX6_MSG_SUBSCRIBE, &msg);
	zassert_equal(phoenix6_get_signal(9, PHOENIX6_SIGNAL_VELOCITY, &v), -ENODATA);

	zassert_equal(phoenix6_subscribe(9, PHOENIX6_SIGNAL_NONE, 1.0f, NULL), -EINVAL);
	zassert_equal(phoenix6_subscribe(9, PHOENIX6_SIGNAL_COUNT, 1.0f, NULL), -EINVAL);
	zassert_equal(phoenix6_subscribe(9, PHOENIX6_SIGNAL_VELOCITY, -1.0f, NULL), -EINVAL);
	zassert_equal(phoenix6_get_signal(9, PHOENIX6_SIGNAL_VELOCITY, NULL), -EINVAL);
}

ZTEST(phoenix6_client, test_corrupt_input_is_ignored)
{
	static const uint8_t garbage[] = {0x13, 0x37, 0x00, 0x05, 0x83, 0x00, 0x00, 0x00};
	int32_t status = 1;

	zassert_equal(uart_emul_put_rx_data(uart_dev, garbage, sizeof(garbage)), sizeof(garbage));
	zassert_ok(phoenix6_clear_sticky_faults(1, 10, &status));
	zassert_equal(status, 0);
	zassert_true(phoenix6_bridge_is_connected());
}

ZTEST_SUITE(phoenix6_client, NULL, client_setup, client_before, NULL, NULL);
```

## src/desc.c
```c
/*
 * Copyright (c) 2026 CANBusRP2040 contributors
 *
 * SPDX-License-Identifier: Apache-2.0
 *
 * Generated Phoenix 6 descriptor tables, initializers and lookup helpers.
 */

#include <string.h>

#include <zephyr/ztest.h>

#include <canbus_rp2040/phoenix6.h>

#include "phoenix6_proto.h"

#define CONTROL_COUNT (PHOENIX6_CONTROL_ID_COUNT - 1)
#define CONFIG_COUNT  (PHOENIX6_CONFIG_COUNT - 1)
#define SIGNAL_COUNT  (PHOENIX6_SIGNAL_COUNT - 1)

static size_t type_size(uint8_t type)
{
	switch (type) {
	case PHOENIX6_TYPE_FLOAT:
		return sizeof(double);
	case PHOENIX6_TYPE_BOOL:
		return sizeof(bool);
	case PHOENIX6_TYPE_INT:
	case PHOENIX6_TYPE_ENUM:
		return sizeof(int32_t);
	default:
		return 0;
	}
}

/* Encode the parameters of a request as sent on the wire */
static size_t encode(const struct phoenix6_control *req, uint8_t *buf, size_t size)
{
	struct phoenix6_writer w;

	phoenix6_writer_init(&w, buf, size);
	zassert_ok(phoenix6_encode_control_params(&w, phoenix6_control_desc_get(req->id),
						  (const uint8_t *)req +
							  PHOENIX6_CONTROL_PARAMS_OFFSET));

	return w.len;
}

ZTEST(phoenix6_desc, test_control_table)
{
	zassert_equal(CONTROL_COUNT, 99, "Phoenix 6 %s has 99 Talon FX control requests",
		      PHOENIX6_GENERATED_VERSION);

	for (int i = 0; i < CONTROL_COUNT; i++) {
		const struct phoenix6_control_desc *d = &phoenix6_control_descs[i];

		zassert_equal(d->id, i + 1);
		zassert_equal_ptr(phoenix6_control_desc_get(d->id), d);
		zassert_equal_ptr(phoenix6_control_desc_find(d->name), d, "%s", d->name);
		zassert_true(d->size > 0 && d->size <= sizeof(struct phoenix6_control) -
							       PHOENIX6_CONTROL_PARAMS_OFFSET);
		/* EmptyControl is the only request without an update frequency */
		zassert_true(d->update_freq_hz > 0 || strcmp(d->name, "EmptyControl") == 0, "%s",
			     d->name);

		for (uint8_t j = 0; j < d->param_count; j++) {
			const struct phoenix6_param_desc *p = &d->params[j];

			if (p->type == PHOENIX6_TYPE_CONTROL) {
				const struct phoenix6_control_desc *sub =
					phoenix6_control_desc_get(p->control);

				zassert_not_null(sub, "%s.%s", d->name, p->name);
				zassert_true(p->offset + sub->size <= d->size);
				zassert_true(p->required);
			} else {
				zassert_true(type_size(p->type) > 0, "%s.%s", d->name, p->name);
				zassert_true(p->offset + type_size(p->type) <= d->size);
				zassert_equal(p->type == PHOENIX6_TYPE_ENUM, p->enum_index != 0xFF,
					      "%s.%s", d->name, p->name);
			}

			if (j > 0) {
				zassert_true(p->offset > d->params[j - 1].offset,
					     "%s: parameters out of order", d->name);
			}
		}
	}

	zassert_is_null(phoenix6_control_desc_get(PHOENIX6_CONTROL_ID_NONE));
	zassert_is_null(phoenix6_control_desc_get(PHOENIX6_CONTROL_ID_COUNT));
	zassert_is_null(phoenix6_control_desc_find("VelocityVoltage2"));
}

ZTEST(phoenix6_desc, test_every_request_fits_a_packet)
{
	struct phoenix6_control req;
	uint8_t buf[PHOENIX6_MAX_PACKET];

	for (int id = 1; id <= CONTROL_COUNT; id++) {
		/* SET_CONTROL: type, seq, device, id, update_freq, params, CRC */
		size_t overhead = 3 + 1 + 2 + 8 + 2;

		zassert_ok(phoenix6_control_init(&req, id));
		zassert_true(encode(&req, buf, sizeof(buf)) + overhead <= PHOENIX6_MAX_PACKET);
	}
}

ZTEST(phoenix6_desc, test_flags)
{
	int pro = 0;
	int canivore = 0;

	for (int i = 0; i < CONTROL_COUNT; i++) {
		pro += (phoenix6_control_descs[i].flags & PHOENIX6_CONTROL_FLAG_PRO) ? 1 : 0;
		canivore +=
			(phoenix6_control_descs[i].flags & PHOENIX6_CONTROL_FLAG_CANIVORE) ? 1 : 0;
	}

	zassert_equal(pro, 66);
	zassert_equal(canivore, 60);

	zassert_equal(phoenix6_control_desc_find("DutyCycleOut")->flags, 0);
	zassert_equal(phoenix6_control_desc_find("VelocityTorqueCurrentFOC")->flags,
		      PHOENIX6_CONTROL_FLAG_PRO);
	zassert_equal(phoenix6_control_desc_find("Diff_VelocityVoltage_Position")->flags,
		      PHOENIX6_CONTROL_FLAG_PRO | PHOENIX6_CONTROL_FLAG_CANIVORE);
}

ZTEST(phoenix6_desc, test_velocity_voltage)
{
	const struct phoenix6_control_desc *d = phoenix6_control_desc_find("VelocityVoltage");
	static const char *const names[] = {
		"velocity",
		"acceleration",
		"enable_foc",
		"feed_forward",
		"slot",
		"override_brake_dur_neutral",
		"limit_forward_motion",
		"limit_reverse_motion",
		"ignore_hardware_limits",
		"ignore_software_limits",
		"use_timesync",
	};

	zassert_not_null(d);
	zassert_equal(d->id, PHOENIX6_CONTROL_ID_VELOCITY_VOLTAGE);
	zassert_equal(d->size, sizeof(struct phoenix6_velocity_voltage));
	zassert_equal(d->update_freq_hz, 100);
	zassert_equal(d->param_count, ARRAY_SIZE(names));

	for (size_t i = 0; i < ARRAY_SIZE(names); i++) {
		zassert_str_equal(d->params[i].name, names[i]);
	}

	zassert_true(d->params[0].required);
	zassert_equal(d->params[0].offset, offsetof(struct phoenix6_velocity_voltage, velocity));
	zassert_false(d->params[2].required);
	zassert_equal(d->params[2].type, PHOENIX6_TYPE_BOOL);
	zassert_equal(d->params[2].default_value, 1.0);
	zassert_equal(d->params[4].type, PHOENIX6_TYPE_INT);
	zassert_equal(d->params[4].offset, offsetof(struct phoenix6_velocity_voltage, slot));
}

ZTEST(phoenix6_desc, test_initializers_match_control_init)
{
	struct {
		struct phoenix6_control macro;
		enum phoenix6_control_id id;
	} cases[] = {
		{PHOENIX6_DUTY_CYCLE_OUT(0.0), PHOENIX6_CONTROL_ID_DUTY_CYCLE_OUT},
		{PHOENIX6_VOLTAGE_OUT(0.0), PHOENIX6_CONTROL_ID_VOLTAGE_OUT},
		{PHOENIX6_VELOCITY_VOLTAGE(0.0), PHOENIX6_CONTROL_ID_VELOCITY_VOLTAGE},
		{PHOENIX6_POSITION_VOLTAGE(0.0), PHOENIX6_CONTROL_ID_POSITION_VOLTAGE},
		{PHOENIX6_MOTION_MAGIC_VOLTAGE(0.0), PHOENIX6_CONTROL_ID_MOTION_MAGIC_VOLTAGE},
		{PHOENIX6_MOTION_MAGIC_EXPO_TORQUE_CURRENT_FOC(0.0),
		 PHOENIX6_CONTROL_ID_MOTION_MAGIC_EXPO_TORQUE_CURRENT_FOC},
		{PHOENIX6_TORQUE_CURRENT_FOC(0.0), PHOENIX6_CONTROL_ID_TORQUE_CURRENT_FOC},
		{PHOENIX6_FOLLOWER(0, 0), PHOENIX6_CONTROL_ID_FOLLOWER},
		{PHOENIX6_NEUTRAL_OUT(), PHOENIX6_CONTROL_ID_NEUTRAL_OUT},
		{PHOENIX6_COAST_OUT(), PHOENIX6_CONTROL_ID_COAST_OUT},
		{PHOENIX6_STATIC_BRAKE(), PHOENIX6_CONTROL_ID_STATIC_BRAKE},
		{PHOENIX6_MUSIC_TONE(0.0), PHOENIX6_CONTROL_ID_MUSIC_TONE},
		{PHOENIX6_DIFF_VELOCITY_VOLTAGE_POSITION(PHOENIX6_VELOCITY_VOLTAGE_PARAMS(0.0),
							 PHOENIX6_POSITION_VOLTAGE_PARAMS(0.0)),
		 PHOENIX6_CONTROL_ID_DIFF_VELOCITY_VOLTAGE_POSITION},
	};
	struct phoenix6_control init;
	uint8_t a[PHOENIX6_MAX_PACKET];
	uint8_t b[PHOENIX6_MAX_PACKET];

	ARRAY_FOR_EACH(cases, i) {
		size_t la;
		size_t lb;

		zassert_equal(cases[i].macro.id, cases[i].id);
		zassert_ok(phoenix6_control_init(&init, cases[i].id));
		zassert_equal(cases[i].macro.update_freq_hz, init.update_freq_hz);

		la = encode(&cases[i].macro, a, sizeof(a));
		lb = encode(&init, b, sizeof(b));
		zassert_equal(la, lb);
		zassert_mem_equal(a, b, la, "%s", phoenix6_control_desc_get(cases[i].id)->name);
	}

	zassert_equal(phoenix6_control_init(&init, PHOENIX6_CONTROL_ID_NONE), -EINVAL);
	zassert_equal(phoenix6_control_init(&init, PHOENIX6_CONTROL_ID_COUNT), -EINVAL);
}

ZTEST(phoenix6_desc, test_control_init_defaults)
{
	struct phoenix6_control req;

	zassert_ok(phoenix6_control_init(&req, PHOENIX6_CONTROL_ID_MOTION_MAGIC_VELOCITY_VOLTAGE));
	zassert_equal(req.id, PHOENIX6_CONTROL_ID_MOTION_MAGIC_VELOCITY_VOLTAGE);
	zassert_equal(req.update_freq_hz, 100.0);
	zassert_true(req.motion_magic_velocity_voltage.enable_foc);
	zassert_equal(req.motion_magic_velocity_voltage.slot, 0);

	/* Nested requests get their own defaults */
	zassert_ok(phoenix6_control_init(&req, PHOENIX6_CONTROL_ID_DIFF_VELOCITY_VOLTAGE_POSITION));
	zassert_true(req.diff_velocity_voltage_position.average_request.enable_foc);
	zassert_true(req.diff_velocity_voltage_position.differential_request.enable_foc);
}

ZTEST(phoenix6_desc, test_config_table)
{
	const struct phoenix6_config_desc *d;

	zassert_equal(CONFIG_COUNT, 100);

	for (int i = 0; i < CONFIG_COUNT; i++) {
		char name[96];

		d = &phoenix6_config_descs[i];
		zassert_equal(d->id, i + 1);
		snprintf(name, sizeof(name), "%s.%s", d->group, d->field);
		zassert_equal_ptr(phoenix6_config_desc_find(name), d, "%s", name);
		zassert_equal(d->type == PHOENIX6_TYPE_ENUM, d->enum_index != 0xFF, "%s", name);
	}

	d = phoenix6_config_desc_find("slot0.k_p");
	zassert_not_null(d);
	zassert_equal(d->id, PHOENIX6_CONFIG_SLOT0_K_P);
	zassert_equal(d->type, PHOENIX6_TYPE_FLOAT);

	d = phoenix6_config_desc_find("motor_output.neutral_mode");
	zassert_not_null(d);
	zassert_equal(d->id, PHOENIX6_CONFIG_MOTOR_OUTPUT_NEUTRAL_MODE);
	zassert_equal(d->type, PHOENIX6_TYPE_ENUM);
	zassert_str_equal(phoenix6_enum_descs[d->enum_index].name, "NeutralModeValue");

	zassert_is_null(phoenix6_config_desc_find("slot0"));
	zassert_is_null(phoenix6_config_desc_find("slot0.k_q"));
	zassert_is_null(phoenix6_config_desc_find("slot.k_p"));
	zassert_is_null(phoenix6_config_desc_find(".k_p"));
}

ZTEST(phoenix6_desc, test_signal_table)
{
	const struct phoenix6_signal_desc *d;

	zassert_equal(SIGNAL_COUNT, 112);

	for (int i = 0; i < SIGNAL_COUNT; i++) {
		d = &phoenix6_signal_descs[i];
		zassert_equal(d->id, i + 1);
		zassert_equal_ptr(phoenix6_signal_desc_find(d->name), d, "%s", d->name);
		zassert_equal(d->type == PHOENIX6_TYPE_ENUM, d->enum_index != 0xFF, "%s", d->name);
	}

	d = phoenix6_signal_desc_find("velocity");
	zassert_not_null(d);
	zassert_equal(d->id, PHOENIX6_SIGNAL_VELOCITY);
	zassert_str_equal(d->unit, "rotations_per_second");

	d = phoenix6_signal_desc_find("control_mode");
	zassert_not_null(d);
	zassert_equal(d->type, PHOENIX6_TYPE_ENUM);
	zassert_str_equal(phoenix6_enum_descs[d->enum_index].name, "ControlModeValue");

	zassert_is_null(phoenix6_signal_desc_find("get_velocity"));
}

ZTEST(phoenix6_desc, test_enums)
{
	const struct phoenix6_config_desc *d =
		phoenix6_config_desc_find("motor_output.neutral_mode");
	int32_t value;

	zassert_ok(phoenix6_enum_value(d->enum_index, "BRAKE", &value));
	zassert_equal(value, PHOENIX6_NEUTRAL_MODE_BRAKE);
	zassert_ok(phoenix6_enum_value(d->enum_index, "COAST", &value));
	zassert_equal(value, PHOENIX6_NEUTRAL_MODE_COAST);
	zassert_equal(phoenix6_enum_value(d->enum_index, "Brake", &value), -ENOENT);
	zassert_equal(phoenix6_enum_value(0xFF, "BRAKE", &value), -ENOENT);

	zassert_str_equal(phoenix6_enum_name(d->enum_index, 1), "BRAKE");
	zassert_is_null(phoenix6_enum_name(d->enum_index, 7));
	zassert_is_null(phoenix6_enum_name(0xFF, 0));

	/* Enum values are Phoenix 6 values, not indices */
	zassert_equal(PHOENIX6_REVERSE_LIMIT_SOURCE_DISABLED, 3);
	zassert_equal(PHOENIX6_REVERSE_LIMIT_SOURCE_REMOTE_CANCODER, 4);
}

ZTEST_SUITE(phoenix6_desc, NULL, NULL, NULL, NULL, NULL);
```

## src/proto.c
```c
/*
 * Copyright (c) 2026 CANBusRP2040 contributors
 *
 * SPDX-License-Identifier: Apache-2.0
 *
 * Wire protocol of the Phoenix 6 bridge: framing and value encoding.
 */

#include <string.h>

#include <zephyr/ztest.h>

#include "phoenix6_proto.h"

ZTEST(phoenix6_proto, test_crc16_check_value)
{
	/* Catalogue check value of CRC-16/CCITT-FALSE */
	zassert_equal(phoenix6_crc16((const uint8_t *)"123456789", 9), 0x29B1);
}

struct cobs_vector {
	const uint8_t *in;
	size_t in_len;
	const uint8_t *out;
	size_t out_len;
};

#define VEC(i, o)                                                                                  \
	{                                                                                          \
		(const uint8_t *)(i), sizeof(i) - 1, (const uint8_t *)(o), sizeof(o) - 1           \
	}

static void check_cobs(const uint8_t *in, size_t in_len, const uint8_t *expected,
		       size_t expected_len)
{
	uint8_t enc[300];
	uint8_t dec[300];
	size_t n;
	int m;

	n = phoenix6_cobs_encode(in, in_len, enc);
	zassert_equal(n, expected_len, "encoded length %zu, expected %zu", n, expected_len);
	zassert_mem_equal(enc, expected, expected_len);
	zassert_true(n <= in_len + in_len / 254U + 1U);

	m = phoenix6_cobs_decode(enc, n, dec, sizeof(dec));
	zassert_equal(m, (int)in_len);
	zassert_mem_equal(dec, in, in_len);
}

ZTEST(phoenix6_proto, test_cobs_short_vectors)
{
	/* Reference vectors of the COBS article on Wikipedia */
	static const struct cobs_vector vectors[] = {
		VEC("", "\x01"),
		VEC("\x00", "\x01\x01"),
		VEC("\x00\x00", "\x01\x01\x01"),
		VEC("\x00\x11\x00", "\x01\x02\x11\x01"),
		VEC("\x11\x22\x00\x33", "\x03\x11\x22\x02\x33"),
		VEC("\x11\x22\x33\x44", "\x05\x11\x22\x33\x44"),
		VEC("\x11\x00\x00\x00", "\x02\x11\x01\x01\x01"),
	};

	ARRAY_FOR_EACH_PTR(vectors, v) {
		check_cobs(v->in, v->in_len, v->out, v->out_len);
	}
}

ZTEST(phoenix6_proto, test_cobs_long_vectors)
{
	uint8_t in[255];
	uint8_t out[258];

	/* 01 02 ... FE -> FF 01 02 ... FE */
	for (int i = 0; i < 254; i++) {
		in[i] = i + 1;
	}
	out[0] = 0xFF;
	memcpy(&out[1], in, 254);
	check_cobs(in, 254, out, 255);

	/* 00 01 02 ... FE -> 01 FF 01 02 ... FE */
	in[0] = 0x00;
	for (int i = 1; i < 255; i++) {
		in[i] = i;
	}
	out[0] = 0x01;
	out[1] = 0xFF;
	memcpy(&out[2], &in[1], 254);
	check_cobs(in, 255, out, 256);

	/* 01 02 ... FE FF -> FF 01 02 ... FE 02 FF */
	for (int i = 0; i < 255; i++) {
		in[i] = i + 1;
	}
	out[0] = 0xFF;
	memcpy(&out[1], in, 254);
	out[255] = 0x02;
	out[256] = 0xFF;
	check_cobs(in, 255, out, 257);

	/* 02 03 ... FF 00 -> FF 02 03 ... FF 01 01 */
	for (int i = 0; i < 254; i++) {
		in[i] = i + 2;
	}
	in[254] = 0x00;
	out[0] = 0xFF;
	memcpy(&out[1], in, 254);
	out[255] = 0x01;
	out[256] = 0x01;
	check_cobs(in, 255, out, 257);

	/* 03 04 ... FF 00 01 -> FE 03 04 ... FF 02 01 */
	for (int i = 0; i < 253; i++) {
		in[i] = i + 3;
	}
	in[253] = 0x00;
	in[254] = 0x01;
	out[0] = 0xFE;
	memcpy(&out[1], in, 253);
	out[254] = 0x02;
	out[255] = 0x01;
	check_cobs(in, 255, out, 256);
}

ZTEST(phoenix6_proto, test_cobs_decode_invalid)
{
	uint8_t out[16];

	/* Zero code byte */
	zassert_equal(phoenix6_cobs_decode((const uint8_t *)"\x02\x11\x00", 3, out, sizeof(out)),
		      -EINVAL);
	/* Block runs past the end */
	zassert_equal(phoenix6_cobs_decode((const uint8_t *)"\x05\x11\x22", 3, out, sizeof(out)),
		      -EINVAL);
	/* Output too small */
	zassert_equal(phoenix6_cobs_decode((const uint8_t *)"\x05\x11\x22\x33\x44", 5, out, 3),
		      -EINVAL);
}

/* Reference packets, identical to the Python implementation's test vectors */
static const uint8_t hello_packet[] = {0x0b, 0x01, 0x02, 0x01, 0x01, 0xb1,
				       0x31, 0x86, 0xca, 0x37, 0x45, 0x00};
static const uint8_t ping_packet[] = {0x02, 0x02, 0x01, 0x03, 0xfc, 0xa2, 0x00};

ZTEST(phoenix6_proto, test_packet_encode_reference)
{
	uint8_t body[5];
	uint8_t out[PHOENIX6_MAX_ENCODED];
	struct phoenix6_writer w;
	int n;

	phoenix6_writer_init(&w, body, sizeof(body));
	phoenix6_put_u8(&w, 1);
	phoenix6_put_u32(&w, 0xca8631b1);
	zassert_false(w.overflow);

	n = phoenix6_packet_encode(PHOENIX6_MSG_HELLO, 0x0102, body, w.len, out, sizeof(out));
	zassert_equal(n, sizeof(hello_packet));
	zassert_mem_equal(out, hello_packet, sizeof(hello_packet));

	n = phoenix6_packet_encode(PHOENIX6_MSG_PING, 0, NULL, 0, out, sizeof(out));
	zassert_equal(n, sizeof(ping_packet));
	zassert_mem_equal(out, ping_packet, sizeof(ping_packet));
}

ZTEST(phoenix6_proto, test_packet_encode_limits)
{
	static uint8_t body[PHOENIX6_MAX_PACKET];
	static uint8_t out[PHOENIX6_MAX_ENCODED];

	/* Largest body: 512 - 3 (type, seq) - 2 (CRC) */
	zassert_true(phoenix6_packet_encode(PHOENIX6_MSG_LOG, 0, body, PHOENIX6_MAX_PACKET - 5, out,
					    sizeof(out)) > 0);
	zassert_equal(phoenix6_packet_encode(PHOENIX6_MSG_LOG, 0, body, PHOENIX6_MAX_PACKET - 4,
					     out, sizeof(out)),
		      -EMSGSIZE);
	zassert_equal(phoenix6_packet_encode(PHOENIX6_MSG_LOG, 0, body, 10, out, 12), -EMSGSIZE);
}

static int feed_all(struct phoenix6_frame_decoder *d, const uint8_t *data, size_t len,
		    struct phoenix6_packet *pkt)
{
	int packets = 0;

	for (size_t i = 0; i < len; i++) {
		if (phoenix6_frame_decoder_feed(d, data[i], pkt)) {
			packets++;
		}
	}

	return packets;
}

ZTEST(phoenix6_proto, test_frame_decoder)
{
	static struct phoenix6_frame_decoder d;
	static uint8_t big[PHOENIX6_MAX_PACKET];
	static uint8_t enc[PHOENIX6_MAX_ENCODED];
	struct phoenix6_packet pkt;
	uint8_t corrupt[sizeof(hello_packet)];
	int n;

	phoenix6_frame_decoder_init(&d);

	zassert_equal(feed_all(&d, hello_packet, sizeof(hello_packet), &pkt), 1);
	zassert_equal(pkt.type, PHOENIX6_MSG_HELLO);
	zassert_equal(pkt.seq, 0x0102);
	zassert_equal(pkt.body_len, 5);
	zassert_mem_equal(pkt.body, "\x01\xb1\x31\x86\xca", 5);

	/* Corrupted packet is dropped, the next one is received */
	memcpy(corrupt, hello_packet, sizeof(corrupt));
	corrupt[4] ^= 0x10;
	zassert_equal(feed_all(&d, corrupt, sizeof(corrupt), &pkt), 0);
	zassert_equal(d.dropped, 1);
	zassert_equal(feed_all(&d, ping_packet, sizeof(ping_packet), &pkt), 1);
	zassert_equal(pkt.type, PHOENIX6_MSG_PING);
	zassert_equal(pkt.body_len, 0);

	/* Garbage without delimiter before a packet is discarded with the packet */
	zassert_equal(feed_all(&d, (const uint8_t *)"\x05\x01", 2, &pkt), 0);
	zassert_equal(feed_all(&d, ping_packet, sizeof(ping_packet), &pkt), 0);
	zassert_equal(d.dropped, 2);

	/* Empty frames between delimiters are ignored */
	zassert_equal(feed_all(&d, (const uint8_t *)"\x00\x00", 2, &pkt), 0);
	zassert_equal(d.dropped, 2);

	/* Largest packet */
	for (size_t i = 0; i < sizeof(big); i++) {
		big[i] = (uint8_t)i;
	}
	n = phoenix6_packet_encode(PHOENIX6_MSG_LOG, 7, big, PHOENIX6_MAX_PACKET - 5, enc,
				   sizeof(enc));
	zassert_true(n > 0);
	zassert_equal(feed_all(&d, enc, n, &pkt), 1);
	zassert_equal(pkt.body_len, PHOENIX6_MAX_PACKET - 5);
	zassert_mem_equal(pkt.body, big, PHOENIX6_MAX_PACKET - 5);

	/* Overlong frame is dropped */
	memset(enc, 0x01, sizeof(enc));
	zassert_equal(feed_all(&d, enc, sizeof(enc), &pkt), 0);
	zassert_equal(feed_all(&d, enc, sizeof(enc), &pkt), 0);
	zassert_true(d.overflow);
	zassert_equal(feed_all(&d, (const uint8_t *)"\x00", 1, &pkt), 0);
	zassert_equal(d.dropped, 3);
	zassert_equal(feed_all(&d, ping_packet, sizeof(ping_packet), &pkt), 1);
}

ZTEST(phoenix6_proto, test_writer_reader)
{
	uint8_t buf[27];
	struct phoenix6_writer w;
	struct phoenix6_reader r;

	phoenix6_writer_init(&w, buf, sizeof(buf));
	phoenix6_put_u8(&w, 0xA5);
	phoenix6_put_u16(&w, 0x1234);
	phoenix6_put_u32(&w, 0xDEADBEEF);
	phoenix6_put_i32(&w, -42);
	phoenix6_put_f32(&w, 1.5f);
	phoenix6_put_f64(&w, -2.25);
	zassert_false(w.overflow);
	zassert_equal(w.len, 23);
	zassert_mem_equal(buf, "\xA5\x34\x12\xEF\xBE\xAD\xDE\xD6\xFF\xFF\xFF", 11);
	/* 1.5f = 0x3FC00000, -2.25 = 0xC002000000000000 */
	zassert_mem_equal(&buf[11], "\x00\x00\xC0\x3F", 4);
	zassert_mem_equal(&buf[15], "\x00\x00\x00\x00\x00\x00\x02\xC0", 8);

	phoenix6_put_f64(&w, 1.0);
	zassert_true(w.overflow);
	zassert_equal(w.len, 23);

	phoenix6_reader_init(&r, buf, 23);
	zassert_equal(phoenix6_get_u8(&r), 0xA5);
	zassert_equal(phoenix6_get_u16(&r), 0x1234);
	zassert_equal(phoenix6_get_u32(&r), 0xDEADBEEF);
	zassert_equal(phoenix6_get_i32(&r), -42);
	zassert_equal(phoenix6_get_f32(&r), 1.5f);
	zassert_equal(phoenix6_get_f64(&r), -2.25);
	zassert_false(r.error);
	zassert_equal(phoenix6_get_u8(&r), 0);
	zassert_true(r.error);
}

ZTEST(phoenix6_proto, test_encode_control_params)
{
	struct phoenix6_control req = PHOENIX6_VELOCITY_VOLTAGE(10.0);
	uint8_t buf[128];
	struct phoenix6_writer w;
	struct phoenix6_reader r;

	req.velocity_voltage.slot = 1;
	req.velocity_voltage.feed_forward = 0.5;
	req.velocity_voltage.enable_foc = false;

	phoenix6_writer_init(&w, buf, sizeof(buf));
	zassert_ok(phoenix6_encode_control_params(&w, phoenix6_control_desc_get(req.id),
						  (const uint8_t *)&req +
							  PHOENIX6_CONTROL_PARAMS_OFFSET));

	/* Phoenix 6 parameter order */
	phoenix6_reader_init(&r, buf, w.len);
	zassert_equal(phoenix6_get_f64(&r), 10.0); /* velocity */
	zassert_equal(phoenix6_get_f64(&r), 0.0);  /* acceleration */
	zassert_equal(phoenix6_get_u8(&r), 0);     /* enable_foc */
	zassert_equal(phoenix6_get_f64(&r), 0.5);  /* feed_forward */
	zassert_equal(phoenix6_get_i32(&r), 1);    /* slot */
	for (int i = 0; i < 6; i++) {
		/* override_brake_dur_neutral ... use_timesync */
		zassert_equal(phoenix6_get_u8(&r), 0);
	}
	zassert_false(r.error);
	zassert_equal(r.pos, r.len);

	/* Too small buffer */
	phoenix6_writer_init(&w, buf, 20);
	zassert_equal(phoenix6_encode_control_params(&w, phoenix6_control_desc_get(req.id),
						     (const uint8_t *)&req +
							     PHOENIX6_CONTROL_PARAMS_OFFSET),
		      -EMSGSIZE);
}

ZTEST(phoenix6_proto, test_encode_nested_control)
{
	struct phoenix6_control req = PHOENIX6_DIFF_VELOCITY_VOLTAGE_POSITION(
		PHOENIX6_VELOCITY_VOLTAGE_PARAMS(5.0), PHOENIX6_POSITION_VOLTAGE_PARAMS(0.25));
	const struct phoenix6_control_desc *vv =
		phoenix6_control_desc_get(PHOENIX6_CONTROL_ID_VELOCITY_VOLTAGE);
	const struct phoenix6_control_desc *pv =
		phoenix6_control_desc_get(PHOENIX6_CONTROL_ID_POSITION_VOLTAGE);
	uint8_t nested[256];
	uint8_t flat[256];
	struct phoenix6_writer w;
	struct phoenix6_writer wf;
	struct phoenix6_control avg = PHOENIX6_VELOCITY_VOLTAGE(5.0);
	struct phoenix6_control diff = PHOENIX6_POSITION_VOLTAGE(0.25);

	phoenix6_writer_init(&w, nested, sizeof(nested));
	zassert_ok(phoenix6_encode_control_params(&w, phoenix6_control_desc_get(req.id),
						  (const uint8_t *)&req +
							  PHOENIX6_CONTROL_PARAMS_OFFSET));

	/* Nested requests are encoded as their parameters, in order */
	phoenix6_writer_init(&wf, flat, sizeof(flat));
	zassert_ok(phoenix6_encode_control_params(
		&wf, vv, (const uint8_t *)&avg + PHOENIX6_CONTROL_PARAMS_OFFSET));
	zassert_ok(phoenix6_encode_control_params(
		&wf, pv, (const uint8_t *)&diff + PHOENIX6_CONTROL_PARAMS_OFFSET));

	zassert_equal(w.len, wf.len);
	zassert_mem_equal(nested, flat, w.len);
}

ZTEST_SUITE(phoenix6_proto, NULL, NULL, NULL, NULL, NULL);
```
