## CMakeLists.txt
```
# Copyright (c) 2026 CANBusRP2040 contributors
# SPDX-License-Identifier: Apache-2.0

cmake_minimum_required(VERSION 3.20.0)

find_package(Zephyr REQUIRED HINTS $ENV{ZEPHYR_BASE})
project(usb_can_adapter)

target_sources(app PRIVATE src/main.c)
```

## sample.yaml
```
sample:
  name: CANable-style slcan USB-to-CAN adapter
  description: |
    Turns a Raspberry Pi Pico with an MCP25625 CAN board into a USB-to-CAN
    adapter that speaks the CANable / Lawicel slcan protocol.
common:
  tags:
    - can
    - usb
  build_only: true
tests:
  sample.canbus_rp2040.usb_can_adapter:
    extra_args: SHIELD=mcp25625_pico
    platform_allow:
      - rpi_pico
      - rpi_pico2/rp2350a/m33
    integration_platforms:
      - rpi_pico
  # Any board with an Arduino R3 header, e.g. Nordic, STM32 Nucleo, NXP FRDM
  sample.canbus_rp2040.usb_can_adapter.arduino:
    extra_args: SHIELD=mcp25625_arduino
    platform_allow:
      - nrf52840dk/nrf52840
    modules:
      - hal_nordic
```

## prj.conf
```kconfig
# CAN controller (MCP25625 via the mcp25625_pico or mcp25625_arduino shield)
CONFIG_CAN=y
CONFIG_CAN_ACCEPT_RTR=y

# slcan protocol over USB CDC ACM
CONFIG_SLCAN=y
CONFIG_SERIAL=y
CONFIG_UART_INTERRUPT_DRIVEN=y

CONFIG_USB_DEVICE_STACK_NEXT=y
CONFIG_USBD_CDC_ACM_CLASS=y
CONFIG_CDC_ACM_SERIAL_INITIALIZE_AT_BOOT=y
CONFIG_CDC_ACM_SERIAL_MANUFACTURER_STRING="CANBusRP2040"
CONFIG_CDC_ACM_SERIAL_PRODUCT_STRING="CANBusRP2040 slcan USB-CAN adapter"
# The Zephyr project VID/PID defaults are only meant for testing. Use your own
# CONFIG_CDC_ACM_SERIAL_VID / CONFIG_CDC_ACM_SERIAL_PID for distributed devices.

# Serial number for the USB descriptor and the slcan N command
CONFIG_HWINFO=y

# Status LED
CONFIG_GPIO=y

# Logging goes to the console UART (GP0/GP1 on a Pico), not to the USB port
CONFIG_LOG=y
CONFIG_USBD_LOG_LEVEL_ERR=y
CONFIG_UDC_DRIVER_LOG_LEVEL_ERR=y
CONFIG_USBD_CDC_ACM_LOG_LEVEL_OFF=y

# The MCP25625 has only two receive buffers; leave plenty of room to absorb
# bursts while the host is busy.
CONFIG_SLCAN_RX_QUEUE_SIZE=256
```

## app.overlay
```dts
/*
 * Copyright (c) 2026 CANBusRP2040 contributors
 *
 * SPDX-License-Identifier: Apache-2.0
 */

&zephyr_udc0 {
	slcan_cdc_acm: cdc_acm_uart0 {
		compatible = "zephyr,cdc-acm-uart";
		label = "CANBusRP2040 slcan";
	};
};
```

## src/main.c
```c
/*
 * Copyright (c) 2026 CANBusRP2040 contributors
 *
 * SPDX-License-Identifier: Apache-2.0
 *
 * CANable-style USB-to-CAN adapter: the MCP25625 CAN controller is exposed
 * over USB CDC ACM using the slcan protocol.
 *
 * Status LED (led0), modelled on the CANable LEDs:
 *   - channel closed: short blink once per second
 *   - channel open:   on, briefly off for every received/transmitted frame
 *   - error:          fast blinking for two seconds (bus error, lost frames)
 */

#include <zephyr/device.h>
#include <zephyr/drivers/gpio.h>
#include <zephyr/kernel.h>
#include <zephyr/logging/log.h>
#include <zephyr/sys/atomic.h>

#include <canbus_rp2040/slcan.h>

LOG_MODULE_REGISTER(usb_can_adapter, LOG_LEVEL_INF);

#define LED_ACTIVITY_MS 25
#define LED_ERROR_MS    2000

static const struct device *const can_dev = DEVICE_DT_GET(DT_CHOSEN(zephyr_canbus));
static const struct device *const uart_dev = DEVICE_DT_GET(DT_NODELABEL(slcan_cdc_acm));

#if DT_NODE_HAS_STATUS_OKAY(DT_ALIAS(led0))
static const struct gpio_dt_spec led = GPIO_DT_SPEC_GET(DT_ALIAS(led0), gpios);
#define HAVE_LED 1
#else
#define HAVE_LED 0
#endif

static atomic_t channel_open;
static atomic_t last_activity_ms;
static atomic_t last_error_ms;

static void slcan_event(enum slcan_event event, void *user_data)
{
	uint32_t now = k_uptime_get_32();

	ARG_UNUSED(user_data);

	switch (event) {
	case SLCAN_EVENT_OPEN:
		atomic_set(&channel_open, 1);
		LOG_INF("channel opened");
		break;
	case SLCAN_EVENT_CLOSE:
		atomic_set(&channel_open, 0);
		LOG_INF("channel closed");
		break;
	case SLCAN_EVENT_RX:
	case SLCAN_EVENT_TX:
		atomic_set(&last_activity_ms, (atomic_val_t)now);
		break;
	case SLCAN_EVENT_ERROR:
		atomic_set(&last_error_ms, (atomic_val_t)now);
		break;
	}
}

static bool led_state(uint32_t now)
{
	uint32_t error_age = now - (uint32_t)atomic_get(&last_error_ms);
	uint32_t activity_age = now - (uint32_t)atomic_get(&last_activity_ms);

	if (atomic_get(&last_error_ms) != 0 && error_age < LED_ERROR_MS) {
		return ((now / 50U) % 2U) == 0U;
	}

	if (atomic_get(&channel_open) == 0) {
		return (now % 1000U) < 50U;
	}

	return activity_age >= LED_ACTIVITY_MS;
}

int main(void)
{
	int err;

	if (!device_is_ready(can_dev)) {
		LOG_ERR("CAN controller %s not ready (check wiring and osc-freq)", can_dev->name);
		return 0;
	}

#if HAVE_LED
	if (gpio_is_ready_dt(&led)) {
		(void)gpio_pin_configure_dt(&led, GPIO_OUTPUT_INACTIVE);
	}
#endif

	err = slcan_uart_start(uart_dev, can_dev, slcan_event, NULL);
	if (err != 0) {
		LOG_ERR("failed to start slcan on %s (err %d)", uart_dev->name, err);
		return 0;
	}

	LOG_INF("slcan USB-CAN adapter ready on %s", can_dev->name);

	while (true) {
#if HAVE_LED
		(void)gpio_pin_set_dt(&led, led_state(k_uptime_get_32()) ? 1 : 0);
#endif
		k_msleep(5);
	}

	return 0;
}
```
