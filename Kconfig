## Kconfig
```kconfig
# Copyright (c) 2026 CANBusRP2040 contributors
# SPDX-License-Identifier: Apache-2.0

menu "CANBusRP2040"

rsource "drivers/Kconfig"
rsource "lib/Kconfig"

endmenu
```

## boards/shields/mcp25625_arduino/Kconfig.shield
```kconfig
# Copyright (c) 2026 CANBusRP2040 contributors
# SPDX-License-Identifier: Apache-2.0

config SHIELD_MCP25625_ARDUINO
	def_bool $(shields_list_contains,mcp25625_arduino)
```

## boards/shields/mcp25625_pico/Kconfig.shield
```kconfig
# Copyright (c) 2026 CANBusRP2040 contributors
# SPDX-License-Identifier: Apache-2.0

config SHIELD_MCP25625_PICO
	def_bool $(shields_list_contains,mcp25625_pico)
```

## drivers/Kconfig
```kconfig
# Copyright (c) 2026 CANBusRP2040 contributors
# SPDX-License-Identifier: Apache-2.0

if CAN

rsource "can/Kconfig"

endif # CAN
```

## drivers/can/Kconfig
```kconfig
# Copyright (c) 2026 CANBusRP2040 contributors
# SPDX-License-Identifier: Apache-2.0

config CAN_MCP25625
	bool "Microchip MCP25625 CAN controller driver"
	default y
	depends on DT_HAS_MICROCHIP_MCP25625_ENABLED
	select SPI
	select GPIO
	help
	  Driver for the Microchip MCP25625 SPI CAN 2.0B controller with
	  integrated CAN transceiver.

if CAN_MCP25625

config CAN_MCP25625_INT_THREAD_STACK_SIZE
	int "Stack size of the interrupt handling thread"
	default 1024
	help
	  Stack size of the driver thread that services the INT pin. CAN RX,
	  TX completion and state change callbacks run on this thread, so
	  increase this if the callbacks need more stack.

config CAN_MCP25625_INT_THREAD_PRIO
	int "Cooperative priority of the interrupt handling thread"
	default 2
	help
	  Cooperative priority of the driver thread that services the INT
	  pin. The MCP25625 only has two receive buffers, so this thread
	  should run with a high priority to avoid receive overruns at high
	  bus loads.

config CAN_MCP25625_MAX_FILTERS
	int "Maximum number of concurrent RX filters"
	default 16
	range 1 32
	help
	  Number of RX filters that can be installed with can_add_rx_filter().
	  Filtering is done in software after the (optional) hardware
	  acceptance filters.

config CAN_MCP25625_STATE_POLL_INTERVAL_MS
	int "Error state polling interval in milliseconds"
	default 50
	range 1 1000
	help
	  The MCP25625 only raises an interrupt when an error flag gets set,
	  not when the controller recovers. While the controller is not in the
	  error-active state, the driver polls the error flags at this
	  interval so recovery (including automatic bus-off recovery) is
	  reported through the state change callback.

config EMUL_MCP25625
	bool "MCP25625 emulator"
	default y
	depends on EMUL
	depends on SPI_EMUL
	depends on GPIO_EMUL
	help
	  SPI emulator for the MCP25625, used to test the driver on native_sim.

endif # CAN_MCP25625
```

## dts/bindings/can/microchip,mcp25625.yaml
```yaml
# Copyright (c) 2026 CANBusRP2040 contributors
# SPDX-License-Identifier: Apache-2.0

description: |
  Microchip MCP25625 CAN 2.0B controller with integrated high-speed CAN
  transceiver, connected over SPI.

  The CAN controller part of the MCP25625 is register compatible with the
  stand-alone MCP2515. The integrated transceiver is controlled through the
  STBY pin (high = standby, low = normal operation).

  Example (Raspberry Pi Pico, SPI0):

    &spi0 {
      status = "okay";
      cs-gpios = <&gpio0 17 GPIO_ACTIVE_LOW>;

      mcp25625: can@0 {
        compatible = "microchip,mcp25625";
        reg = <0>;
        spi-max-frequency = <DT_FREQ_M(10)>;
        osc-freq = <DT_FREQ_M(16)>;
        int-gpios = <&gpio0 20 GPIO_ACTIVE_LOW>;
        standby-gpios = <&gpio0 21 GPIO_ACTIVE_HIGH>;
        bitrate = <1000000>;
      };
    };

compatible: "microchip,mcp25625"

include: [spi-device.yaml, can-controller.yaml]

properties:
  osc-freq:
    type: int
    required: true
    description: |
      Frequency of the oscillator/crystal connected to OSC1/OSC2 in Hz.
      Common values on breakout boards are 8, 16 and 20 MHz. The MCP25625
      CAN core runs from osc-freq / 2.

  int-gpios:
    type: phandle-array
    required: true
    description: |
      Interrupt (INT) pin. The MCP25625 drives this pin low when an enabled
      interrupt is pending, so it is normally described as GPIO_ACTIVE_LOW.

  standby-gpios:
    type: phandle-array
    description: |
      Optional GPIO connected to the STBY pin of the integrated transceiver.
      The pin is asserted (transceiver in standby) while the CAN controller is
      stopped and de-asserted while it is started. The MCP25625 enters standby
      when STBY is high, so this is normally GPIO_ACTIVE_HIGH. Omit this
      property if STBY is tied low on the board.

  reset-gpios:
    type: phandle-array
    description: |
      Optional GPIO connected to the RESET pin (active low). If present, the
      driver pulses it during initialization in addition to the SPI RESET
      instruction.

  clkout-prescaler:
    type: int
    default: 0
    enum:
      - 0
      - 1
      - 2
      - 4
      - 8
    description: |
      Configure the CLKOUT pin to output the oscillator frequency divided by
      the given value. 0 (the default) disables CLKOUT.
```

## lib/Kconfig
```kconfig
# Copyright (c) 2026 CANBusRP2040 contributors
# SPDX-License-Identifier: Apache-2.0

rsource "slcan/Kconfig"
rsource "frc_can/Kconfig"
rsource "kraken/Kconfig"
rsource "phoenix6/Kconfig"
```

## lib/frc_can/Kconfig
```kconfig
# Copyright (c) 2026 CANBusRP2040 contributors
# SPDX-License-Identifier: Apache-2.0

config FRC_CAN
	bool "FIRST CAN identifier and heartbeat helpers"
	help
	  Helpers for the publicly documented FIRST (FRC/FTC) CAN identifier
	  layout, broadcast messages and universal heartbeat.
```

## lib/kraken/Kconfig
```kconfig
# Copyright (c) 2026 CANBusRP2040 contributors
# SPDX-License-Identifier: Apache-2.0

menuconfig KRAKEN
	bool "Kraken X60 / X44 motor support"
	select FRC_CAN
	help
	  Motor data and model, PWM control and a CAN bus monitor for
	  WestCoast Products Kraken motors (Talon FX motor controller).

if KRAKEN

config KRAKEN_PWM
	bool "PWM control"
	default y
	depends on PWM
	help
	  Drive a Kraken with RC-style PWM pulses (1-2 ms) on the wires that
	  are otherwise used for CAN.

config KRAKEN_PWM_PERIOD_US
	int "PWM period in microseconds"
	default 5000
	range 2900 100000
	depends on KRAKEN_PWM
	help
	  The Talon FX accepts PWM periods between 2.9 ms and 100 ms.

config KRAKEN_CAN_MONITOR
	bool "CAN bus monitor"
	default y
	depends on CAN
	help
	  Record which CTR Electronics devices (e.g. Kraken motors) are
	  present on the CAN bus, and the robot controller heartbeat.

config KRAKEN_CAN_MONITOR_MAX_DEVICES
	int "Maximum number of devices tracked"
	default 16
	range 1 64
	depends on KRAKEN_CAN_MONITOR

config KRAKEN_CAN_MONITOR_API_IDS
	int "Distinct API identifiers recorded per device"
	default 8
	range 1 32
	depends on KRAKEN_CAN_MONITOR

endif # KRAKEN
```

## lib/phoenix6/Kconfig
```kconfig
# Copyright (c) 2026 CANBusRP2040 contributors
# SPDX-License-Identifier: Apache-2.0

menuconfig PHOENIX6
	bool "Phoenix 6 control requests through the host bridge"
	depends on SERIAL
	depends on SERIAL_SUPPORT_INTERRUPT
	select UART_INTERRUPT_DRIVEN
	select RING_BUFFER
	select CRC
	help
	  Talon FX (Kraken X60/X44) control requests, configuration and status
	  signals with the Phoenix 6 API, executed by the official Phoenix 6
	  library on a host connected over a serial link (host/phoenix6_bridge).

if PHOENIX6

module = PHOENIX6
module-str = phoenix6
source "subsys/logging/Kconfig.template.log_config"

config PHOENIX6_THREAD_STACK_SIZE
	int "Client thread stack size"
	default 2048

config PHOENIX6_THREAD_PRIORITY
	int "Client thread priority"
	default 5

config PHOENIX6_RX_BUF_SIZE
	int "Receive buffer size"
	default 1024

config PHOENIX6_TX_BUF_SIZE
	int "Transmit buffer size"
	default 2048

config PHOENIX6_TX_TIMEOUT_MS
	int "Maximum time to wait for transmit buffer space"
	default 50

config PHOENIX6_MAX_PENDING
	int "Requests waiting for an answer at the same time"
	default 4
	range 1 16

config PHOENIX6_SIGNAL_CACHE_SIZE
	int "Number of status signals cached"
	default 32
	range 1 255

config PHOENIX6_LINK_TIMEOUT_MS
	int "Link timeout in milliseconds"
	default 500
	help
	  The link to the host bridge is considered lost when nothing was
	  received for this time. The host bridge uses the same timeout and
	  stops all motors when it expires.

config PHOENIX6_KEEPALIVE_MS
	int "Keepalive interval in milliseconds"
	default 100
	help
	  Interval of the PING packets sent to the host bridge. The bridge
	  answers each one, so both sides see traffic even when no other
	  requests are answered (e.g. while only the enable is fed).

config PHOENIX6_RESPONSE_MARGIN_MS
	int "Extra time to wait for an answer in milliseconds"
	default 200
	help
	  Added to the timeout passed to the Phoenix 6 call on the host to
	  account for the serial link and the host.

endif # PHOENIX6
```

## lib/slcan/Kconfig
```kconfig
# Copyright (c) 2026 CANBusRP2040 contributors
# SPDX-License-Identifier: Apache-2.0

menuconfig SLCAN
	bool "slcan (Lawicel / CANable) serial line CAN protocol"
	depends on CAN
	select POLL
	help
	  Implements the ASCII serial line CAN protocol used by CANable and
	  Lawicel adapters, so a Zephyr CAN controller can be used as a
	  USB-to-CAN adapter by Linux SocketCAN (slcand), python-can and
	  similar tools.

if SLCAN

module = SLCAN
module-str = slcan
source "subsys/logging/Kconfig.template.log_config"

config SLCAN_RX_QUEUE_SIZE
	int "Receive queue size in frames"
	default 64
	help
	  Number of received CAN frames buffered while waiting to be sent to
	  the host. Frames are dropped (and reported with the F command and an
	  "e1o" error message) when the queue is full.

config SLCAN_TX_TIMEOUT_MS
	int "Transmit timeout in milliseconds"
	default 100
	help
	  How long a transmit command waits for a free CAN TX buffer before it
	  is rejected with BEL.

config SLCAN_CMD_ACK
	bool "Acknowledge commands with CR / BEL"
	default y
	help
	  Reply to each command with CR on success and BEL on failure, as
	  Lawicel adapters do. The CANable slcan firmware sends no replies;
	  disable this option to mimic it exactly.

config SLCAN_TX_ACK
	bool "Acknowledge transmit commands with z / Z"
	help
	  Reply to t/r commands with "z" and to T/R commands with "Z" instead
	  of CR, as Lawicel CANUSB adapters do.

config SLCAN_STATE_REPORTS
	bool "Report CAN error state changes"
	default y
	help
	  Send "s<state><rx errors><tx errors>" messages when the CAN
	  controller changes error state. Recent Linux slcan drivers
	  convert these into SocketCAN error frames.

config SLCAN_ERROR_REPORTS
	bool "Report lost frames"
	default y
	help
	  Send an "e1o" message (RX overrun, as parsed by the Linux slcan
	  driver) when received frames had to be dropped.

config SLCAN_HW_VERSION
	int "Hardware version reported by the V command"
	default 1
	range 0 99

config SLCAN_SW_VERSION
	int "Software version reported by the V command"
	default 1
	range 0 99

config SLCAN_UART
	bool "UART / USB CDC ACM transport"
	default y
	depends on SERIAL
	depends on SERIAL_SUPPORT_INTERRUPT
	select UART_INTERRUPT_DRIVEN
	select RING_BUFFER
	help
	  Provide slcan_uart_start(), which runs the slcan protocol on a UART
	  such as a USB CDC ACM instance.

if SLCAN_UART

config SLCAN_UART_INSTANCES
	int "Number of UARTs that can run slcan at the same time"
	default 1
	range 1 8
	help
	  Each instance bridges one CAN controller to one UART (e.g. one USB
	  CDC ACM port per CAN bus) and has its own thread and buffers.

config SLCAN_UART_THREAD_STACK_SIZE
	int "Transport thread stack size"
	default 1536

config SLCAN_UART_THREAD_PRIORITY
	int "Transport thread priority"
	default 5

config SLCAN_UART_RX_BUF_SIZE
	int "Host to device buffer size"
	default 512

config SLCAN_UART_TX_BUF_SIZE
	int "Device to host buffer size"
	default 4096

config SLCAN_UART_TX_TIMEOUT_MS
	int "Maximum time to wait for the host to read output"
	default 20
	help
	  Output is dropped when the host does not read it within this time,
	  so a disconnected host cannot stall the adapter.

endif # SLCAN_UART

endif # SLCAN
```

## tests/drivers/can/mcp25625/testcase.yaml
```yaml
common:
  tags:
    - drivers
    - can
  platform_allow:
    - native_sim
    - native_sim/native/64
  integration_platforms:
    - native_sim/native/64
tests:
  canbus_rp2040.drivers.can.mcp25625: {}
```

## tests/drivers/can/zephyr_api/testcase.yaml
```yaml
common:
  tags:
    - drivers
    - can
  platform_allow:
    - native_sim
    - native_sim/native/64
  integration_platforms:
    - native_sim/native/64
tests:
  canbus_rp2040.drivers.can.zephyr_api: {}
  canbus_rp2040.drivers.can.zephyr_api.rtr:
    extra_configs:
      - CONFIG_CAN_ACCEPT_RTR=y
```

## tests/drivers/can/zephyr_timing/testcase.yaml
```yaml
common:
  tags:
    - drivers
    - can
  platform_allow:
    - native_sim
    - native_sim/native/64
  integration_platforms:
    - native_sim/native/64
tests:
  canbus_rp2040.drivers.can.zephyr_timing: {}
  canbus_rp2040.drivers.can.zephyr_timing.all_bitrates:
    extra_configs:
      - CONFIG_TEST_ALL_BITRATES=y
```

## tests/lib/slcan_uart/testcase.yaml
```yaml
common:
  tags:
    - can
    - slcan
  platform_allow:
    - native_sim
    - native_sim/native/64
  integration_platforms:
    - native_sim/native/64
tests:
  canbus_rp2040.lib.slcan_uart: {}
  canbus_rp2040.lib.slcan_uart.two_instances:
    extra_configs:
      - CONFIG_SLCAN_UART_INSTANCES=2
```
